## package/ezp-httpd-v2/config/Config.in
```kconfig
config HTTPD_WIDGET_SHOW
        bool "Widget"
        default y

config HTTPD_LOGO_SHOW
        bool "Logo"
        default y

config HTTPD_COPYRIGH_TEXT
        string
        prompt "Copyrigth text"
        default "AXIM_Communications_Inc."
        help 
            Input text to display copyright infomation. Use the underline to replace the blank.

config HTTPD_DISPLAY
    int
    default 1          if HTTPD_WIDGET_SHOW
    default 0
```

## target/linux/generic-2.6/files-2.6.26/drivers/char/nvram_cfg/Kconfig
```kconfig
#
# NVRAM_CFG device configuration
#

config NVRAM_CFG
	tristate "EZ Packet NVRAM kernel module"
	---help---
	  This is used for EZ Packet configuration respository.
```

## target/linux/generic-2.6/files-2.6.26/drivers/usb/drxvi314/Kconfig
```kconfig
config USB_BECEEM_WIMAX
        tristate "Beseem WiMAX i314 support"
        ---help---
          This driver supports Beseem WiMAX i314
```

## target/linux/ralink/files/arch/mips/rt2880/Kconfig
```kconfig
if RALINK_RT2880

choice
        prompt "Soc Hardware Type"
	default RT2880_ASIC

config  RT2880_ASIC 
        bool "RT2880-ASIC"
endchoice

endif
#-----------------------------

if RALINK_RT3052

choice
        prompt "Soc Hardware Type"
	default RT3052_ASIC

config  RT3052_ASIC 
        bool "RT305x/RT3350-ASIC"
endchoice

config RALINK_RT3350
	bool "Ralink RT3350 chipset"

choice
    prompt "Board type"
    default ABOCOM_5205

    config ABOCOM_5205
        bool "ABOCOM 5205"

    config ABOCOM_5205G
        bool "ABOCOM 5205G"

    config ABOCOM_4615G
        bool "ABOCOM 4615G"

    config AMIT_CDM530AM
        bool "AMIT CDM530AM"

    config AMIT_CDW531AC
        bool "AMIT CDW531AC"

    config AMIT_CDE550
        bool "AMIT CDE550"

    config AMIT_CDE570
        bool "AMIT CDE570"

    config BAUDTEC_RA300R1H
        bool "BAUDTEC_RA300R1H 2T2R 1 Lan 1 Wan"

    config BAUDTEC_RA300R4H
        bool "BAUDTEC_RA300R4H 2T2R 4 Lan 1 Wan"

    config BAUDTEC_RA300R4G
        bool "BAUDTEC_RA300R4G 2T2R 4 Lan 1 Wan, AR8316 giga switch"

endchoice

endif

#---------------------------

if RALINK_RT3352

choice
        prompt "Soc Hardware Type"
	default RT3352_ASIC

config  RT3352_ASIC 
	bool "RT3352-ASIC"
	select USB_ARCH_HAS_OHCI
	select USB_ARCH_HAS_EHCI

endchoice

choice
    prompt "Board type"
    default BOARD_GMA

    config BOARD_GMA
        bool "Garmin-marine-board"

endchoice

endif

#--------------------------
 
if RALINK_RT3883

choice
        prompt "Soc Hardware Type"
	default RT3883_ASIC

config  RT3883_ASIC 
	bool "RT3883/RT3662-ASIC"
	select USB_ARCH_HAS_OHCI
	select USB_ARCH_HAS_EHCI
endchoice

choice
        prompt "RT3883 PCI architecture"
	default PCIE_PCI_CONCURRENT

config PCIE_PCI_CONCURRENT
        bool "PCIE RC and PCI HOST CONCURRENT"
config PCIE_ONLY
        bool "PCIE RC ONLY"
config PCI_ONLY
        bool "PCI HOST ONLY"
config PCIE_PCI_NONE
        bool "Non-support PCI/PCIe"
endchoice

endif

#---------------------------

if RALINK_RT5350

choice
	prompt "Soc Hardware Type"
	default RT5350_ASIC

config	RT5350_ASIC 
	bool "RT5350-ASIC"
	select USB_ARCH_HAS_OHCI
	select USB_ARCH_HAS_EHCI

endchoice

choice
    prompt "Board type"
    default BOARD_AME

    config BOARD_AME
        bool "MR-102NV2"

    config BOARD_AXA
        bool "MR-102N-M1"

    config BOARD_AXB
        bool "MR-102N-Bee"

    config BOARD_LIS
        bool "MR-102N-Sony"

    config BOARD_AMD
        bool "MR-102N-Bee"

    config BOARD_AXM
        bool "MR-102N-Music"

endchoice

endif

#--------------------------

config FLASH_REMAP_NEED
       bool
       default y if (RALINK_RT2880)
choice
       prompt "DRAM Size"
       default RT2880_DRAM_16M

config RT2880_DRAM_8M
       bool "8M"

config RT2880_DRAM_16M
       bool "16M"

config RT2880_DRAM_32M
       bool "32M"

config RT2880_DRAM_64M
       bool "64M"

endchoice

choice
       prompt "RT3052 flash Size"
       default RT3052_FLASH_8M
       depends on RALINK_RT3052 || RALINK_RT3352

config RT3052_FLASH_4M
       bool "FLASH 4M"

config RT3052_FLASH_8M
       bool "FLASH 8M"

config RT3052_FLASH_16M
       bool "FLASH 16M"

endchoice


choice
       prompt "Flash Type"
       default MTD_ANY_RALINK

config MTD_NOR_RALINK
       bool "NOR"
       depends on  !RALINK_RT3352 && !RALINK_RT5350 && !RALINK_RT6855

config MTD_SPI_RALINK
       bool "SPI"
       depends on  !RALINK_RT2880

config MTD_NAND_RALINK
       bool "NAND"
       depends on  !RALINK_RT3352 && !RALINK_RT2880 && !RALINK_RT5350 && !RALINK_RT6855

config MTD_ANY_RALINK
       bool "ANY (NOR/SPI/NAND)"
       depends on  !RALINK_RT3352 && !RALINK_RT5350

endchoice


choice
       prompt "Flash Size"
       default RT2880_FLASH_4M
#       depends on  FLASH_REMAP_NEED
       depends on  FLASH_REMAP_NEED || DUAL_IMAGE

config RT2880_FLASH_2M
       bool "2M"
       depends on  !DUAL_IMAGE

config RT2880_FLASH_4M
       bool "4M"

config RT2880_FLASH_8M
       bool "8M"

config RT2880_FLASH_16M
       bool "16M"

endchoice

config  DUAL_IMAGE
	bool 'Dual Image' 

config  KERNEL_NVRAM
	bool 'Kernel NVRAM' 
	default n

#config  RT2880_FLASH_32M
#        bool "Flash Size 32MB Support"
#	depends on (RALINK_RT3052_MP2 || RALINK_RT3350) && !MTD_SPI_RALINK
#	select MTD_CONCAT if RT2880_FLASH_32M 

config  FLASH_128K_SECTOR
        bool "128Kb Sector Size Support"
        depends on RT3052_FLASH_16M

config  RALINK_RAM_SIZE
	int 
	default 8 if RT2880_DRAM_8M
	default 16 if RT2880_DRAM_16M
	default 32 if RT2880_DRAM_32M
	default 64 if RT2880_DRAM_64M
	default 128 if RT2880_DRAM_128M

config MTD_PHYSMAP_START
       hex 
       default 0xBFC00000 if RT2880_FLASH_2M && !RALINK_RT3052
       default 0xBFC00000 if RT2880_FLASH_4M && !RALINK_RT3052
       default 0xBF400000 if RT2880_FLASH_8M && !RALINK_RT3052
       default 0xBEC00000 if RT2880_FLASH_16M && !RALINK_RT3052
       default 0xBF000000 if RT2880_FLASH_32M && !RALINK_RT3052
       default 0xBF000000 if !FLASH_REMAP_NEED && RALINK_RT3052
       default 0x1C000000 if !FLASH_REMAP_NEED && RALINK_RT3352
       default 0x1C000000 if !FLASH_REMAP_NEED && RALINK_RT5350
       default 0x1C000000 if !FLASH_REMAP_NEED && RALINK_RT3883

config MTD_PHYSMAP_LEN
       hex 
       default 0x200000 if RT2880_FLASH_2M
       default 0x400000 if RT2880_FLASH_4M
       default 0x800000 if RT2880_FLASH_8M
       default 0x1000000 if RT2880_FLASH_16M
       default 0x2000000 if RT2880_FLASH_32M
       default 0x1000000 if !FLASH_REMAP_NEED

config MTD_PHYSMAP_BUSWIDTH
       int 
       default 2

choice
	prompt "Root File System Type"
	default RT2880_ROOTFS_IN_RAM

config  RT2880_ROOTFS_IN_RAM
        bool "RootFS_in_RAM"
	select BLK_DEV_INITRD 
	select BLK_DEV_RAM 

config  RT2880_ROOTFS_IN_FLASH
        bool "RootFS_in_FLASH"
endchoice

config BLK_DEV_RAM_SIZE
	int 'Default RAM disk size'
	default 8192
	depends on RT2880_ROOTFS_IN_RAM

config	LZMARAMFS
	bool "Compress ramdisk by lzma instead of gzip"
	depends on RT2880_ROOTFS_IN_RAM

config ROOTFS_IN_FLASH_NO_PADDING
	bool 'No Padding between Kernel and RootFS'
	default n
	depends on RT2880_ROOTFS_IN_FLASH && !RT2880_FLASH_32M && !DUAL_IMAGE

config MTD_KERNEL_PART_SIZ
	hex 'MTD Kernel Partition Size (Unit:Bytes)'
	default 0xD0000
	depends on RT2880_ROOTFS_IN_FLASH && !ROOTFS_IN_FLASH_NO_PADDING

config  RALINK_TIMER
	tristate 'Ralink WatchDog' 

config  RALINK_TIMER_WDG
        bool "Ralink WatchDog Timer"
        depends on RALINK_TIMER

config  RALINK_TIMER_WDG_RESET_OUTPUT
        bool "Ralink WatchDog Reset Output"
        depends on RALINK_TIMER_WDG

config  RALINK_WDG_TIMER
        int "WatchDog Timer (Unit:1Sec, Max=30Sec)"
        default 10
        depends on RALINK_TIMER_WDG

config  RALINK_WDG_REFRESH_INTERVAL
        int "WatchDog Refresh Interval (Unit:1Sec, Max=30Sec)"
        default 4
        depends on RALINK_TIMER_WDG

config  RALINK_TIMER_DFS
        bool "Ralink DFS Timer"

config RALINK_EXTERNAL_TIMER
	bool "Ralink External Timer"
	depends on RALINK_RT3352 || RALINK_RT5350 || RALINK_RT6855

config  RT2860V2_2850
        bool "Dual Band"
        depends on RALINK_RT2880

choice
        prompt "RF Type"
        depends on RALINK_RT5350
        default RALINK_RT5350_1T1R

        config  RALINK_RT5350_1T1R
        bool "1T1R"
endchoice

choice
        prompt "RF Type"
        depends on RALINK_RT3052
        default RALINK_RT3052_2T2R

        config  RALINK_RT3050_1T1R
        bool "1T1R"

        config  RALINK_RT3051_1T2R
        bool "1T2R"

        config  RALINK_RT3052_2T2R
        bool "2T2R"
endchoice

choice
        prompt "RF Type"
        depends on  RALINK_RT3352

        config  RALINK_RT3352_2T2R
        bool "2T2R"
endchoice

choice
    prompt "RF Type"
    depends on RALINK_RT3883

    config  RALINK_RT3662_2T2R
    bool "2T3R (RT3662)"

    config  RALINK_RT3883_3T3R
    bool "3T3R (RT3883)"
endchoice

config  UNIQUE_WPS
    bool "Unique WPS for Concurrent AP"
        depends on RT2860V2_AP_WSC
        depends on RT3090_AP_WSC || RT3572_AP_WSC || RT5392_AP_WSC || RT5572_AP_WSC
    default n
```
